## Kconfig
```kconfig
menuconfig ZMK_SVG
  bool "Enable Nice!View status screen"
    depends on ZMK_DISPLAY && SETTINGS
    select LV_USE_IMAGE
    select LV_USE_LABEL
    select LV_USE_ARC
    select LV_USE_THEME_MONO
    select LV_FONT_UNSCII_8
    select LV_FONT_MONTSERRAT_8
    select LV_FONT_MONTSERRAT_12
    select LV_FONT_MONTSERRAT_20
    select ZMK_SPLIT_BLE_STATUS_SYNC if ZMK_SPLIT && ZMK_SPLIT_BLE
    select ZMK_SPLIT_BLE_CENTRAL_BATTERY_LEVEL_FETCHING if ZMK_SPLIT_ROLE_CENTRAL && ZMK_SPLIT_BLE
    help
      Use the Nice!View status screen and optional split status sync.

config ZMK_SVG_WHITE_BACKGROUND
  bool "Keep the Nice!View screen background white"
    depends on ZMK_SVG
    default n
    help
      Keep empty and transparent screen areas white, even when the legacy
      Nice!View widget inversion option is enabled.

config ZMK_SVG_SCREEN
    bool "Use generated LVGL XML status screen"
    depends on ZMK_SVG
    default y
    help
      Render the generated monochrome LVGL XML screen and native status bindings.
      The screen sources must be regenerated when the XML source changes.

    choice ZMK_SVG_THEME
      prompt "Nice!View screen theme"
      depends on ZMK_SVG_SCREEN
      default ZMK_SVG_THEME_AUTO

    config ZMK_SVG_THEME_AUTO
      bool "Automatic (match display resolution)"

    config ZMK_SVG_THEME_LEFT
      bool "Left"

    config ZMK_SVG_THEME_RIGHT
      bool "Right"

    endchoice

    config ZMK_SVG_CENTRAL_RIGHT_HALF
      bool "The split central is the physical right half"
      depends on ZMK_SVG && ZMK_SPLIT
      default n
      help
        Set this when the central firmware belongs to the physical right side.
        This is separate from whether the current firmware runs on the central.

config ZMK_SVG_RIGHT_HALF
    bool "This display is on the right half"
    depends on ZMK_SVG && ZMK_SPLIT
    default n
    help
      Select the right half in the split indicator on this display.
```
